
/ {
    matrix {
        compatible = "zmk,matrix-transform";
        rows = <6>;
        cols = <6>;
        zephyr,matrix-gpios = <
            &gpio0 0 GPIO_ACTIVE_HIGH /* Row 0 */
            &gpio0 1 GPIO_ACTIVE_HIGH /* Row 1 */
            &gpio0 2 GPIO_ACTIVE_HIGH /* Row 2 */
            &gpio0 3 GPIO_ACTIVE_HIGH /* Row 3 */
            &gpio0 4 GPIO_ACTIVE_HIGH /* Row 4 */
            &gpio0 5 GPIO_ACTIVE_HIGH /* Row 5 */
            &gpio1 0 GPIO_ACTIVE_HIGH /* Column 0 */
            &gpio1 1 GPIO_ACTIVE_HIGH /* Column 1 */
            &gpio1 2 GPIO_ACTIVE_HIGH /* Column 2 */
            &gpio1 3 GPIO_ACTIVE_HIGH /* Column 3 */
            &gpio1 4 GPIO_ACTIVE_HIGH /* Column 4 */
            &gpio1 5 GPIO_ACTIVE_HIGH /* Column 5 */
        >;
    };
};
